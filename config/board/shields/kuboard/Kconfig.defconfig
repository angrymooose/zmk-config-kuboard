## config/board/shields/kuboard/Kconfig.defconfig
```kconfig
if SHIELD_KUBOARD_LEFT

config ZMK_KEYBOARD_NAME
    default "kuboard"

config ZMK_SPLIT_ROLE_CENTRAL
    default y

endif

if SHIELD_KUBOARD_LEFT || SHIELD_KUBOARD_RIGHT

config ZMK_SPLIT
    default y

endif
```

## config/board/shields/kuboard/Kconfig.shield
```kconfig
config SHIELD_KUBOARD_LEFT
    def_bool $(shields_list_contains,kuboard_left)

config SHIELD_KUBOARD_RIGHT
    def_bool $(shields_list_contains,kuboard_right)
```
